
/*
* SD card attached to SPI bus as follows:
** MOSI     - pin 11
** MISO     - pin 12
** CLK(SCK) - pin 13
** CS       - pin 10
*/
#include <SD.h>
#include <SPI.h>
#include <SoftwareSerial.h>
#define rxPin 8
#define txPin 9


SoftwareSerial bluetooth(rxPin, txPin); // RX, TX
File myFile;
int intPrivKey; //Converted string. For computation
int intPubKey; //Generated by controller. Send to Bluetooth
long intProdKey; //intPrivKey * intPubKey
long intAndroidKey; //productkey sent by android
String strAndroidKey; //productkey message to be converted to int
String strPrivKey; //privatekey message to be converted to int
String signal; 
int charCount;

void setup(){
 Serial.begin(9600); 
 bluetooth.begin(9600);
 Serial.print("Initializing SD card...");
 pinMode(10, OUTPUT);
 digitalWrite(10, HIGH);  
 if (!SD.begin(10)) {
   Serial.println("Card failed, or not present");
   return;
 }
 Serial.println("card initialized.");
}

void loop()
{
  while (bluetooth.available()){
    do{
    charCount = 0;
    char s;
      s = bluetooth.read();
      if(isDigit(s)){
      signal +=(char)s;
        charCount++;
      }
    }while(charCount!=1);
    Serial.println("= = = = = = = = = =");
    Serial.println("Receiving data . . .");
    Serial.print("Signal: "); //show the data
    Serial.println(signal); //show the data
    if (signal == "1"){
      setPrivateKey();
    }
    else if (signal == "2"){
      checkProdKey();
    }
    else if (signal == "3"){
      Serial.println("Verifying . . ");
      checkUserNamePassword();
    }
    else if(signal == "4"){
      Serial.println("Adding Device . . .");
      addDevice();
    }
    else if (signal == "5"){
      Serial.println("Deleting Device . . ");
      deleteDevice();
    }
    else if (signal == "6"){
      //delete this and the method
      Serial.println("Sending Devices . . ");
      sendDevices();
    }
    else if (signal == "7"){
      Serial.println("Changing . . . ");
      changeUserPass();
    }
    else if (signal == "8"){
      Serial.println("Name . . . ");
      sendMacAdd();
    }
    signal = "";
  }
}

void overwriteFile(String tempFileName, String dataToWrite){
  char filename[tempFileName.length()+1];
  tempFileName.toCharArray(filename, sizeof(filename));
  SD.remove(filename);
  myFile = SD.open(filename, FILE_WRITE);
  myFile.print(dataToWrite);
  myFile.close();
  delay(1000);
}

String getDataFromFile(String tempFileName){
  char filename[tempFileName.length()+1];
  tempFileName.toCharArray(filename, sizeof(filename)); 
  String data;
  myFile = SD.open(filename);
  if (myFile) {
    while (myFile.available()) {
      data += char( myFile.read());  
    }
    myFile.close();
    delay(1000);
    return data;
  } else {
    Serial.println("error opening test.txt");
    delay(1000);
    
    return "";
  } 
}


void checkUserNamePassword(){
  String androidUserPass;
  while(bluetooth.available()){
    androidUserPass += char(bluetooth.read());
  }  
  Serial.print("Received Android User and Pass: ");
  Serial.print(androidUserPass);
  androidUserPass.trim();
  
  if(androidUserPass == getDataFromFile("admin.txt")){
   Serial.println("OK"); 
   bluetooth.println("1");
   
  }
  else{
    Serial.println("Invalid");
    bluetooth.println("0");
  }
}
void setPrivateKey(){
  resetValue();
  char myChar;
  while(bluetooth.available()){
    myChar = bluetooth.read();
    if(isDigit(myChar)){
      strPrivKey +=(char)myChar;
    }
  }
    intPrivKey = strPrivKey.toInt();
    strPrivKey = "";
    //new private key, reset all values
    generatePublicKey();    
    delay(1000);
    sendPublicKey();
}

void generatePublicKey(){
  intPubKey = (int) random(1000, 9973); //9973 highest 4-digit prime
  intProdKey = (long) intPubKey * intPrivKey;
}

void sendPublicKey(){
  bluetooth.println(intPubKey);
  //
  Serial.println("Sending Public Key . . .");
}

void resetValue(){
  intPubKey = 0;
  intPrivKey = 0;
  intProdKey = 0;
  strPrivKey = "";
  strAndroidKey = "";
  signal = "";
}

void checkProdKey(){
  char myChar;
  while(bluetooth.available()){
    myChar = bluetooth.read();
    if(isDigit(myChar)){
      strAndroidKey +=(char)myChar;
    }
  }
  Serial.println("Receiving Android Product Key . . .");
    intAndroidKey = strAndroidKey.toInt();
    strAndroidKey = "";

 if(intAndroidKey == intProdKey){
     Serial.println("Valid Android Product Key . . .");
     bluetooth.println("1");
  digitalWrite(13, HIGH);
  delay(3000);
  digitalWrite(13, LOW);
 } else{
   bluetooth.println("0");
   Serial.println("Invalid Android Product Key . . .");
   digitalWrite(13, LOW);
 }
 resetValue();
} 

void addDevice(){
  
  int noOfDevices = 0;
  String addressestoAdd;
  while (bluetooth.available()){
    addressestoAdd += char(bluetooth.read());
  }
 
 if(!SD.exists("user1.txt")){
  overwriteFile("user1.txt", addressestoAdd);
  bluetooth.println("user1");
 } 
 else if(!SD.exists("user2.txt")){
   overwriteFile("user2.txt", addressestoAdd);
  bluetooth.println("user2");
 }
  else if(!SD.exists("user3.txt")){
   overwriteFile("user3.txt", addressestoAdd);
  bluetooth.println("user3");
 }
  else {
  bluetooth.println("Error");
 }
}


void changeUserPass(){
 delay(1000); 
 String newusernamepass;
  while (bluetooth.available()){
    newusernamepass += char(bluetooth.read());
 }
 newusernamepass.trim();
 overwriteFile("admin.txt", newusernamepass);
 bluetooth.println("1");
}

//send mac address for verification
void sendMacAdd(){
  char myChar;
  int user;
  while(bluetooth.available()){
    myChar = bluetooth.read();
    if(isDigit(myChar)){
      user = myChar - '0';
    }
  }
  if(user == 1){
    bluetooth.println(getDataFromFile("user1.txt"));
  }
  else if(user == 2){
    bluetooth.println(getDataFromFile("user2.txt"));
  }
  else if(user == 3){
    bluetooth.println(getDataFromFile("user3.txt"));
  }
}

void deleteDevice(){
  char myChar;
  int user;
  while(bluetooth.available()){
    myChar = bluetooth.read();
    if(isDigit(myChar)){
      user = myChar - '0';
    }
  }
  if(user == 1){
    SD.remove("user1.txt");
    bluetooth.println("Success");
  }
  else if(user == 2){
    SD.remove("user2.txt");
    bluetooth.println("Success");
  }
  else if(user == 3){
    SD.remove("user3.txt");
    bluetooth.println("Success");
  }
}

void sendDevices(){
 if(!SD.exists("user1.txt")){
  bluetooth.println(2);
 } 
 if(!SD.exists("user2.txt")){
  bluetooth.println(2);
 }
 if(!SD.exists("user3.txt")){
  bluetooth.println(3);
 }
}
